/ {
	reserved-memory {
		ramoops: ramoops {
			compatible = "ramoops";
			reg = <0 0x91400000 0 0x400000>;
			record-size = <0x80000>;
			console-size = <0x100000>;
			pmsg-size = <0x200000>;
		};
	};
};
